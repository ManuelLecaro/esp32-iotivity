## main/Kconfig.projbuild
```kconfig
menu "IoTivity Example Configuration"

config WIFI_SSID
    string "WiFi SSID"
	default "myssid"
	help
		SSID (network name) for the ESP32 to connect to.

config WIFI_PASSWORD
    string "WiFi Password"
	default "myssid"
	help
		WiFi password (WPA or WPA2) for the ESP32 to match.
		can be blank if the network has no security set.

choice ESP32_IOTIVITY_MODE
    prompt "iotivity: mode select"
    default IOTIVITY_CLIENT
    help
        select iotivity mode(client/server/blinker/blinker_server).

config IOTIVITY_CLIENT
    bool "iotivity client"
 
config IOTIVITY_SERVER
    bool "iotivity server"

config IOTIVITY_SERVER_BLINKER
    bool "iotivity server blinker"

config IOTIVITY_CLIENT_BLINKER
    bool "iotivity client blinker"

endchoice

config OC_DEBUG
    bool "OC_DEBUG"
    help
        enable or disable IoTivity-constrained debug

config APP_DEBUG
    bool "APP_DEBUG"
    help
        enable or disable application debug

config ENABLE_PLUG
    bool "ENABLE_PLUG"
    help
        enable or disable plug options

config ENABLE_LIGHT
    bool "ENABLE_LIGHT"
    help
        enable or disable light

config DYNAMIC
    bool "DYNAMIC"
    help
        enable or disable DYNAMIC

config SECURE
    bool "SECURE"
    help
        enable or disable SECURE

config IPV4
    bool "IPV4"
    help
        enable or disable IPV4

config TCP
    bool "TCP"
    help
        enable or disable TCP

config PKI
    bool "PKI"
    help
        enable or disable OC_PKI


endmenu
```
